## base_external/package/aesd-char-driver/Config.in
```kconfig
config BR2_PACKAGE_AESD_CHAR_DRIVER
	bool "aesd-char-driver"
	help
	  Device drivers for AESD buildroot assignment 8
```

## base_external/package/aesd-chardriver/Config.in
```kconfig
config BR2_PACKAGE_AESD_CHARDRIVER
	bool "aesd-chardriver"
	help
	  Device drivers for AESD buildroot assignment 8
```

## base_external/package/ldd/Config.in
```kconfig
   config BR2_PACKAGE_LDD
   bool "ldd"
   help
     Includes basic kernel modules including ldd and scull modules along with and some startup scripts
```
